#include "./LCD/ST7567a.h"
#include "stdlib.h"
#include  <math.h>



//12*12 ASCII字符集点阵
const unsigned char asc2_1206[95][12]= {
    {0x00,0x00,0x00,0x00,0x00,0x00,0x00,0x00,0x00,0x00,0x00,0x00},/*" ",0*/
    {0x00,0x00,0xFC,0x00,0x00,0x00,0x00,0x00,0x02,0x00,0x00,0x00},/*"!",1*/
    {0x00,0x0C,0x02,0x0C,0x02,0x00,0x00,0x00,0x00,0x00,0x00,0x00},/*""",2*/
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    {0x02,0x01,0x02,0x04,0x04,0x02,0x00,0x00,0x00,0x00,0x00,0x00},/*"~",94*/
};

//16*16 ASCII字符集点阵
const unsigned char asc2_1608[][16]= {
    {0x00,0x00,0x00,0x00,0x00,0x00,0x00,0x00,0x00,0x00,0x00,0x00,0x00,0x00,0x00,0x00},/*" ",0*/
    {0x00,0x00,0x00,0xF8,0x00,0x00,0x00,0x00,0x00,0x00,0x00,0x33,0x30,0x00,0x00,0x00},/*"!",1*/
    {0x00,0x10,0x0C,0x06,0x10,0x0C,0x06,0x00,0x00,0x00,0x00,0x00,0x00,0x00,0x00,0x00},/*""",2*/
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    {0x00,0x06,0x01,0x01,0x02,0x02,0x04,0x04,0x00,0x00,0x00,0x00,0x00,0x00,0x00,0x00},/*"~",94*/
};
//24*24 ASICII字符集点阵
const unsigned char asc2_2412[][36]= {
    {0x00,0x00,0x00,0x00,0x00,0x00,0x00,0x00,0x00,0x00,0x00,0x00,0x00,0x00,0x00,0x00,0x00,0x00,0x00,0x00,0x00,0x00,0x00,0x00,0x00,0x00,0x00,0x00,0x00,0x00,0x00,0x00,0x00,0x00,0x00,0x00},/*" ",0*/
    {0x00,0x00,0x00,0x00,0x00,0xF0,0xF0,0xF0,0x00,0x00,0x00,0x00,0x00,0x00,0x00,0x00,0x00,0x01,0x7F,0x01,0x00,0x00,0x00,0x00,0x00,0x00,0x00,0x00,0x00,0x1C,0x1C,0x1C,0x00,0x00,0x00,0x00},/*"!",1*/
    {0x00,0x00,0x80,0x60,0x30,0x1C,0x8C,0x60,0x30,0x1C,0x0C,0x00,0x00,0x00,0x00,0x00,0x00,0x00,0x00,0x00,0x00,0x00,0x00,0x00,0x00,0x00,0x00,0x00,0x00,0x00,0x00,0x00,0x00,0x00,0x00,0x00},/*""",2*/
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    {0x00,0x18,0x06,0x02,0x02,0x04,0x08,0x10,0x20,0x20,0x30,0x08,0x00,0x00,0x00,0x00,0x00,0x00,0x00,0x00,0x00,0x00,0x00,0x00,0x00,0x00,0x00,0x00,0x00,0x00,0x00,0x00,0x00,0x00,0x00,0x00},/*"~",94*/
};




void DelayXms(uint16_t nms)
{
    uint16_t i,j;
    for(i = 0 ; i < nms ; i++)
        for(j = 0 ; j <1150 ; j++);
}
void DelayXus(uint16_t nus)
{
    uint16_t i;
    for(i = 0; i< nus; i++);
}
void SendByte(unsigned char databyte)
{

    unsigned char i;

    for(i=0; i<8; i++)
    {
//		 SID=(bit)(databyte&0x80);
        if(databyte&0x80)
        {
            ST7567_SDIN_1;//
        }
        else
        {
            ST7567_SDIN_0;//
        }


        ST7567_SCLK_1;
        DelayXus(2);

        ST7567_SCLK_0;
        DelayXus(2);
        databyte=databyte<<1;
    }
}

void SendCmdWord(unsigned char cmdh,unsigned char cmdl)
{
    ST7567_A0_0;
    ST7567_CS_0;
    SendByte(cmdh);
    ST7567_CS_1;

    ST7567_A0_0;
    ST7567_CS_0;
    SendByte(cmdl);
    ST7567_CS_1;

}

void SendCmdByte(unsigned char cmd1)
{
    ST7567_A0_0;
    ST7567_CS_0;
    SendByte(cmd1);
    ST7567_CS_1;

}

void SendDataByte(unsigned char data1)
{

    ST7567_A0_1;
    ST7567_CS_0;
    SendByte(data1);
    ST7567_CS_1;
}

void LcdReset()
{   ST7567_CS_0;
    ST7567_RST_1;
    DelayXms(10);
    ST7567_RST_0;
    DelayXms(100);
    ST7567_RST_1;
    DelayXms(50);
}


void LcdFill(unsigned char buffera,unsigned char bufferb,unsigned char bufferc,unsigned char bufferd)
{

    unsigned char page,n;


    for(page=0xb0; page<0xb8; page++)
    {
        SendCmdByte(page);
        SendCmdWord(ColumnAddrH,ColumnAddrL);


        for(n=0; n<33; n++)
        {
            SendDataByte(buffera);
            SendDataByte(bufferb);
            SendDataByte(bufferc);
            SendDataByte(bufferd);
        }
    }
}

//=============================================================================
//void LcdFrame()
//{
//	unsigned char page,n;
//	unsigned int i=0;
//	for(page=0xb0;page<0xb8;page++)
//	{
//		SendCmdByte(page);
//		SendCmdWord(ColumnAddrH,ColumnAddrL);
//		for(n=0;n<132;n++)
//		{
//			SendDataByte(picture[i++]);
//		}
//	}
//}



void dispchar(unsigned char page,unsigned char CaddrH,unsigned char CaddrL,unsigned char size, unsigned char num)
{
    unsigned char i;
    unsigned char num_local = num - ' ';
    if(size == 24)
    {
        SendCmdByte(page);
        SendCmdWord(CaddrH,CaddrL);
        for(i=0; i<12;)
        {
            SendDataByte(asc2_2412[num_local][i++]);
        }

        SendCmdByte(page+0x01);
        SendCmdWord(CaddrH,CaddrL);
        for(i=12; i<24;)
        {
            SendDataByte(asc2_2412[num_local][i++]);
        }

        SendCmdByte(page+0x02);
        SendCmdWord(CaddrH,CaddrL);
        for(i=24; i<36;)
        {
            SendDataByte(asc2_2412[num_local][i++]);
        }
    }
    else if(size == 16)
    {
        SendCmdByte(page);
        SendCmdWord(CaddrH,CaddrL);
        for(i=0; i<8;)
        {
            SendDataByte(asc2_1608[num_local][i++]);
        }

        SendCmdByte(page+0x01);
        SendCmdWord(CaddrH,CaddrL);
        for(i=8; i<16;)
        {
            SendDataByte(asc2_1608[num_local][i++]);
        }
    }
    else if(size == 12)
    {
        SendCmdByte(page);
        SendCmdWord(CaddrH,CaddrL);
        for(i=0; i<6;)
        {
            SendDataByte(asc2_1206[num_local][i++]);
        }

        SendCmdByte(page+0x01);
        SendCmdWord(CaddrH,CaddrL);
        for(i=6; i<12;)
        {
            SendDataByte(asc2_1206[num_local][i++]);
        }
    }

}

//显示字符串
//x,y:起点坐标
//size1:字体大小
//*chr:字符串起始地址
//mode:0,反色显示;1,正常显示
void ShowString(unsigned char page,unsigned char CaddrH,unsigned char CaddrL,char *chr,u8 size1)
{
    while((*chr>=' ')&&(*chr<='~'))//判断是不是非法字符!
    {
        //OLED_ShowChar(x,y,*chr,size1,mode);
        dispchar(page,CaddrH,CaddrL,size1,*chr);
        if(size1==16)
        {
            CaddrL+=8;
            if(CaddrL>0xf)
            {
                CaddrL-=0xf;
                CaddrH++;
            }
            if(CaddrH>0x18)
            {
                CaddrH = 0x10;
                page++;
            }
        }
        else if(size1 == 24)
        {
            CaddrL+=12;
            if(CaddrL>0xf)
            {
                CaddrL-=0xf;
                CaddrH++;
            }
            if(CaddrH>0x18)
            {
                CaddrH = 0x10;
                page++;
            }
        }
        else
        {
            CaddrL+=6;
            if(CaddrL>0xf)
            {
                CaddrL-=0xf;
                CaddrH++;
            }
            if(CaddrH>0x18)
            {
                CaddrH = 0x10;
                page++;
            }
        }
        chr++;
    }
}


void LcdInitial()
{
    GPIO_InitTypeDef  GPIO_InitStructure;
    RCC_APB2PeriphClockCmd(	RCC_APB2Periph_GPIOC, ENABLE );	//使能GPIOB时钟
    GPIO_InitStructure.GPIO_Pin = GPIO_Pin_1|GPIO_Pin_3;
    GPIO_InitStructure.GPIO_Mode = GPIO_Mode_Out_PP;
    GPIO_InitStructure.GPIO_Speed = GPIO_Speed_50MHz;
    GPIO_Init(GPIOC, &GPIO_InitStructure);
    GPIO_SetBits(GPIOC,GPIO_Pin_1|GPIO_Pin_3);


    RCC_APB2PeriphClockCmd(	RCC_APB2Periph_GPIOF, ENABLE );	//使能GPIOF时钟
    GPIO_InitStructure.GPIO_Pin = GPIO_Pin_1|GPIO_Pin_2|GPIO_Pin_3;
    GPIO_InitStructure.GPIO_Mode = GPIO_Mode_Out_PP;
    GPIO_InitStructure.GPIO_Speed = GPIO_Speed_50MHz;
    GPIO_Init(GPIOF, &GPIO_InitStructure);
    GPIO_SetBits(GPIOF,GPIO_Pin_1|GPIO_Pin_2|GPIO_Pin_3);



    LcdReset();
//	LCD_light_0;
    DelayXms(20);

    SendCmdByte(SegDirection);
    DelayXms(20);
    SendCmdByte(ComDirection);
    DelayXms(20);

    SendCmdByte(BiasSet);
    SendCmdByte(RratioSet);
    SendCmdWord(EVcomd,EVcomdValue);
    DelayXms(20);
    SendCmdByte(PowerControl1);
    DelayXms(20);
    SendCmdByte(PowerControl2);
    DelayXms(20);
    SendCmdByte(PowerControl3);
    DelayXms(20);


    SendCmdByte(StartLine);
    SendCmdWord(ColumnAddrH,ColumnAddrL);
    SendCmdByte(PageAddr);
    SendCmdByte(DispON);
    LcdFill(0x00,0x00,0x00,0x00);
}













